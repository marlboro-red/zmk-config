## config/west.yml
```yaml
manifest:
  remotes:
    - name: zmkfirmware
      url-base: https://github.com/zmkfirmware
    - name: joaopedropio                            
      url-base: https://github.com/joaopedropio   
  projects:
    - name: zmk
      remote: zmkfirmware
      revision: main
      import: app/west.yml
    - name: snake-prospector-zmk-module                 # <--- and these
      remote: joaopedropio                          # <---
      revision: master       
  self:
    path: config
```
